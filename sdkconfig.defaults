## sdkconfig.defaults
```kconfig
CONFIG_LWIP_HOOK_IP6_ROUTE_DEFAULT=y
CONFIG_EXAMPLE_CONNECT_IPV6=n
CONFIG_PARTITION_TABLE_SINGLE_APP_LARGE=y
CONFIG_HUSARNET_LOG_LEVEL_DEBUG=y

CONFIG_ESP_TASK_WDT_TIMEOUT_S=10
CONFIG_FREERTOS_HZ=1000
CONFIG_MBEDTLS_PSK_MODES=y
CONFIG_MBEDTLS_KEY_EXCHANGE_PSK=y
```
